#include <behaviors.dtsi>
#include <dt-bindings/zmk/keys.h>
#include <dt-bindings/zmk/bt.h>

// Layers Index
#define L1 0
#define L2 1
#define Fn 2

// Combos Constants
#define COMBO_TERM_DEFAULT 30
#define COMBO_QUICK_TAP_MS 100

#include "combos.dtsi"

// Layers
#include "L1.dtsi"
#include "L2.dtsi"
#include "Fn.dtsi"
