#include <behaviors.dtsi>
#include <dt-bindings/zmk/keys.h>
#include <dt-bindings/zmk/bt.h>

// Layers
#define base 0
#define lower 1
#define raise 2


// Combos Constants
#define COMBO_TERM_DEFAULT 30
#define COMBO_QUICK_TAP_MS 100

#include "combos.dtsi"

// Layers
#include "default_layer.dtsi"
#include "lower_layer.dtsi"
#include "raise_layer.dtsi"
