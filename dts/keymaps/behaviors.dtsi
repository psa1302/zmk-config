/ {
  behaviors {
    tp: tap_preferred {
      compatible = "zmk,behavior-hold-tap";
      label = "TAP_PREFERRED";
      #binding-cells = <2>;
      tapping-term-ms = <150>;
      quick-tap-ms = <0>;
      flavor = "tap-preferred";
      bindings = <&kp>, <&kp>;
    };
  };
};
